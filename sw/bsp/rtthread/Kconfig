## sw/bsp/rtthread/Kconfig
```kconfig
mainmenu "RT-Thread Configuration"

config BSP_DIR
    string
    option env="BSP_ROOT"

config RTT_DIR
    string
    option env="RTT_ROOT"

source "$RTT_DIR/Kconfig"
source "$BSP_DIR/board/Kconfig"
```

## sw/bsp/rtthread/board/Kconfig
```kconfig
menu "Ydrasil BSP"

config SOC_YDRASIL
    bool
    default y
    select ARCH_RISCV32

config BSP_USING_SIM_CONSOLE
    bool "Use the 0x80200060 simulation output register"
    default n
    help
        This is the only console endpoint currently implemented in the FPGA
        integration. It is write-only and therefore cannot provide FinSH input.

config BSP_USING_UART0
    bool "Enable UART0 console"
    default y
    help
        Use UART0 at 0x40002000 as the console and FinSH input device.

config BSP_USING_MTIME_TICK
    bool "Enable CLINT machine-timer tick"
    default y
    help
        Enable only after MTIME, MTIMECMP and machine-timer interrupt delivery
        are implemented and verified in hardware.

config BSP_USING_PLIC
    bool "Enable PLIC external interrupts"
    default y
    help
        Enable only after the PLIC and machine-external interrupt path are
        connected in hardware.

config BSP_USING_COREMARK
    bool "Build CoreMark as the RT-Thread main application"
    default n
    help
        This option is selected by the BSP Makefile benchmark targets. CoreMark
        itself is an integer workload and does not require the FPU.

endmenu
```

## sw/rt-thread-5.2.2/Kconfig.utestcases
```kconfig
menu "RT-Thread Utestcases"

    config RT_USING_UTESTCASES
        bool "RT-Thread Utestcases"
        default n
        select RT_USING_UTEST
        select RT_USING_DEBUG if !RT_USING_ULOG

    if RT_USING_UTESTCASES

        rsource "src/utest/Kconfig"

        menu "Kernel Components"

            menu "Drivers"
                rsource "components/drivers/core/utest/Kconfig"
                rsource "components/drivers/ipc/utest/Kconfig"
                rsource "components/drivers/serial/utest/Kconfig"
            endmenu

            rsource "components/libc/cplusplus/utest/Kconfig"
            rsource "components/utilities/utest/utest/Kconfig"

        endmenu

endif

endmenu
```

## sw/rt-thread-5.2.2/components/drivers/Kconfig
```kconfig
menu "Device Drivers"

rsource "core/Kconfig"
rsource "ipc/Kconfig"

rsource "serial/Kconfig"
rsource "cputime/Kconfig"
rsource "i2c/Kconfig"
rsource "misc/Kconfig"
rsource "mtd/Kconfig"
rsource "pm/Kconfig"
rsource "rtc/Kconfig"
rsource "spi/Kconfig"
rsource "watchdog/Kconfig"
rsource "sensor/Kconfig"
rsource "graphic/Kconfig"
rsource "led/Kconfig"
rsource "block/Kconfig"
rsource "regulator/Kconfig"
rsource "reset/Kconfig"
rsource "dma/Kconfig"
rsource "pic/Kconfig"
rsource "pin/Kconfig"
rsource "ktime/Kconfig"
rsource "clk/Kconfig"
rsource "hwtimer/Kconfig"

endmenu
```
